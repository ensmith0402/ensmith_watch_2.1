## sdkconfig.defaults
```kconfig
# Target
CONFIG_IDF_TARGET="esp32s3"

# Шрифты LVGL
CONFIG_LV_FONT_MONTSERRAT_14=y
CONFIG_LV_FONT_MONTSERRAT_16=y
CONFIG_LV_FONT_MONTSERRAT_18=y
CONFIG_LV_FONT_MONTSERRAT_20=y
CONFIG_LV_FONT_MONTSERRAT_24=y
CONFIG_LV_FONT_MONTSERRAT_32=y
CONFIG_LV_FONT_MONTSERRAT_48=y

# Отключаем демо LVGL
CONFIG_LV_USE_DEMO_WIDGETS=n
CONFIG_LV_USE_DEMO_BENCHMARK=n
CONFIG_LV_USE_DEMO_RENDER=n
CONFIG_LV_USE_DEMO_SCROLL=n
CONFIG_LV_USE_DEMO_STRESS=n
CONFIG_LV_USE_DEMO_TRANSFORM=n
CONFIG_LV_USE_DEMO_MUSIC=n
CONFIG_LV_USE_DEMO_MULTILANG=n
CONFIG_LV_USE_DEMO_FLEX_LAYOUT=n

# PSRAM
CONFIG_SPIRAM=y
CONFIG_SPIRAM_MODE_OCT=y
CONFIG_SPIRAM_SPEED_80M=y
CONFIG_SPIRAM_BOOT_INIT=y
CONFIG_SPIRAM_USE_MALLOC=y
CONFIG_SPIRAM_TRY_ALLOCATE_WIFI_LWIP=y

# Flash
CONFIG_ESPTOOLPY_FLASHSIZE_16MB=y
CONFIG_ESPTOOLPY_FLASHSIZE="16MB"
CONFIG_ESPTOOLPY_FLASHMODE_DIO=y
CONFIG_ESPTOOLPY_FLASHFREQ_80M=y

# Partition table
CONFIG_PARTITION_TABLE_CUSTOM=y
CONFIG_PARTITION_TABLE_CUSTOM_FILENAME="partitions.csv"

# Экономия IRAM
CONFIG_COMPILER_OPTIMIZATION_SIZE=y
CONFIG_ESP_WIFI_IRAM_OPT=n
CONFIG_ESP_WIFI_RX_IRAM_OPT=n
CONFIG_FREERTOS_PLACE_FUNCTIONS_INTO_FLASH=y
CONFIG_HEAP_PLACE_FUNCTION_INTO_FLASH=y

# LVGL буфер
CONFIG_BSP_DISPLAY_LVGL_BUF_HEIGHT=100

# WiFi Config Web UI
CONFIG_WIFI_CFG_ENABLE_WEBUI=y
CONFIG_ESP_TASK_WDT_TIMEOUT_S=10
CONFIG_HTTPD_MAX_URI_HANDLERS=16
CONFIG_HTTPD_MAX_URI_HANDLERS=16
CONFIG_PM_ENABLE=y
CONFIG_PM_DFS_INIT_AUTO=y
CONFIG_FREERTOS_USE_TICKLESS_IDLE=y
CONFIG_PM_LIGHT_SLEEP_CALLBACKS=y
CONFIG_BSP_DISPLAY_LVGL_TOUCH_DISABLE=y
```
